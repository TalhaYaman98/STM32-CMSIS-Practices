# file: CMSIS_Practices.ioc
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Mcu.Family=STM32F4
Mcu.Name=STM32F407V(E-G)Tx
Mcu.Package=LQFP100
NVIC.PriorityGroup=NVIC_PRIORITYGROUP_0
PH0-OSC_IN.Mode=HSE-External-Oscillator
PH0-OSC_IN.Signal=RCC_OSC_IN
PH1-OSC_OUT.Mode=HSE-External-Oscillator
PH1-OSC_OUT.Signal=RCC_OSC_OUT
ProjectManager.HeapSize=0x200
ProjectManager.StackSize=0x400
ProjectManager.TargetToolchain=STM32CubeIDE
RCC.48MHZClocksFreq_Value=48000000
RCC.AHBFreq_Value=168000000
RCC.APB1CLKDivider=RCC_HCLK_DIV4
RCC.APB1Freq_Value=42000000
RCC.APB1TimFreq_Value=84000000
RCC.APB2CLKDivider=RCC_HCLK_DIV2
RCC.APB2Freq_Value=84000000
RCC.APB2TimFreq_Value=168000000
RCC.CortexFreq_Value=168000000
RCC.HCLKFreq_Value=168000000
RCC.HSE_VALUE=8000000
RCC.HSI_VALUE=16000000
RCC.PLLM=8
RCC.PLLN=336
RCC.PLLQ=7
RCC.PLLSourceVirtual=RCC_PLLSOURCE_HSE
RCC.SYSCLKFreq_VALUE=168000000
RCC.SYSCLKSource=RCC_SYSCLKSOURCE_PLLCLK
RCC.VCOOutputFreq_Value=336000000
board=STM32F407G-DISC1

// file: Core/Src/main.c
/* USER CODE BEGIN Header */
/**
  ******************************************************************************
  * @file           : main.c
  * @brief          : Main program body
  ******************************************************************************
  * @attention
  *
  * Copyright (c) 2026 STMicroelectronics.
  * All rights reserved.
  *
  * This software is licensed under terms that can be found in the LICENSE file
  * in the root directory of this software component.
  * If no LICENSE file comes with this software, it is provided AS-IS.
  *
  ******************************************************************************
  */
/* USER CODE END Header */
#include "main.h"

#include "HeaderForAll.h"

/* USER CODE BEGIN PD */
#if WATCHDOG_CMSIS
#define WDG_TEST_SELECT   4   /* <-- Test numarasını buradan değiştir (1-4) */
#endif
/* USER CODE END PD */

/* USER CODE BEGIN PV */
#if WATCHDOG_CMSIS
volatile uint8_t wwdg_current = 0;
volatile uint32_t reset_reason = 0;
volatile uint8_t  test_a_locked = 0;   /* TEST A için: kilitlenme durumu göstergesi */
#endif

#if RTC_CMSIS
uint8_t hour, min, sec;
uint8_t year, month, day, weekday;

uint8_t ts_h, ts_m, ts_s;
#endif

#if FLASH_CMSIS
uint32_t read_data[4]  = {0};
uint32_t write_data[4] = {0xDEADBEEF, 0x12345678, 0xAABBCCDD, 0x11223344};
#endif
/* USER CODE END PV */

void SystemClock_Config(void);
static void MX_GPIO_Init(void);

int main(void)
{

  /* MCU Configuration--------------------------------------------------------*/

  /* Reset of all peripherals, Initializes the Flash interface and the Systick. */
  HAL_Init();

  /* Configure the system clock */
  SystemClock_Config();

  /* Initialize all configured peripherals */
  MX_GPIO_Init();
  /* USER CODE BEGIN 2 */

#if ADC_CMSIS
  GPIO_PA0_Analog_Init();
  ADC1_Init();
#endif

#if DAC_CMSIS
  GPIO_PA4_Analog_Init();
  DAC_Init();
#endif

#if PWM_CMSIS
  GPIO_PD12_PWM_Init();
  TIM4_PWM_Init(1000, 50);
#endif

#if GPIO_Interrupt_CMSIS
  GPIO_Interrupt_Init();
  Exti0_Init();
#endif

#if TIMER_CMSIS
  GPIO_PD12_Timer_Init();
  TIM2_1HZ_Init();
#endif

#if UART_CMSIS
  GPIO_UART_Init();
  USART2_Init();
  USART2_Send_String("UART OK\r\n");
#endif

#if I2C_CMSIS
  I2C1_Init();
#endif

#if SPI_CMSIS
  GPIO_SPI1_Init();
  SPI1_Init();
#endif

#if SYSTICK_CMSIS
  SysTick_Init();

  // PD12 GPIO Init (SysTick örneğini görmek için)
  RCC->AHB1ENR |= RCC_AHB1ENR_GPIODEN;          // GPIOD clock enable
  (void)RCC->AHB1ENR;                            // Bus senkronizasyonu
  GPIOD->MODER  &= ~(3 << (12 * 2));             // PD12 mod bitlerini temizle
  GPIOD->MODER  |=  (1 << (12 * 2));             // PD12 → Output (01)
  GPIOD->OTYPER &= ~(1 << 12);                   // Push-pull
  GPIOD->OSPEEDR|=  (3 << (12 * 2));             // Very high speed
  GPIOD->PUPDR  &= ~(3 << (12 * 2));             // No pull
  GPIOD->BSRR    =  (1 << (12 + 16));            // Başlangıçta LED kapalı
#endif

#if DMA_CMSIS
  // UART DMA örneği
//  GPIO_UART_Init();
//  USART2_Init();
  DMA_UART_Init();

  uint8_t msg[] = "DMA ile UART gonderimi!\r\n";
  DMA_UART_Transmit(msg, sizeof(msg) - 1);

  // ADC DMA örneği
//  GPIO_PA0_Analog_Init();
//  ADC1_Init();
  DMA_ADC_Init();

  uint16_t adc_buf[10] = {0};
  DMA_ADC_Start(adc_buf, 10);
#endif

#if WATCHDOG_CMSIS
  /* Debug sırasında watchdog'ların durmasını sağla */
  DBGMCU->APB1FZ |= DBGMCU_APB1_FZ_DBG_IWDG_STOP | DBGMCU_APB1_FZ_DBG_WWDG_STOP;

  /* Reset sebebini oku ve Watch'tan izle: reset_reason */
  reset_reason = RCC->CSR;
  RCC->CSR |= RCC_CSR_RMVF;   /* Flag'leri temizle (sonraki teste hazırlık) */

  #if (WDG_TEST_SELECT == 1)
    /* TEST A: IWDG init — IWDG_clk = 32000/64 = 500 Hz, RLR=2499 -> ~5 sn timeout */
    IWDG_Init(4, 2499);

  #elif (WDG_TEST_SELECT == 2)
    /* TEST B1: WWDG init — refresh while döngüsünde hemen pencere ihlali yapacak */
    WWDG_Init(0x7F, 0x5F, 3);

  #elif (WDG_TEST_SELECT == 3)
    /* TEST B2: WWDG init — refresh hiç çağrılmayacak, timeout reseti beklenecek */
    WWDG_Init(0x7F, 0x5F, 3);

  #elif (WDG_TEST_SELECT == 4)
    /* TEST B3: WWDG init — pencere içinde doğru refresh yapılacak */
    WWDG_Init(0x7F, 0x5F, 3);

    // PD12 GPIO Init
    RCC->AHB1ENR |= RCC_AHB1ENR_GPIODEN;          // GPIOD clock enable
    (void)RCC->AHB1ENR;                            // Bus senkronizasyonu
    GPIOD->MODER  &= ~(3 << (12 * 2));             // PD12 mod bitlerini temizle
    GPIOD->MODER  |=  (1 << (12 * 2));             // PD12 → Output (01)
    GPIOD->OTYPER &= ~(1 << 12);                   // Push-pull
    GPIOD->OSPEEDR|=  (3 << (12 * 2));             // Very high speed
    GPIOD->PUPDR  &= ~(3 << (12 * 2));             // No pull
    GPIOD->BSRR    =  (1 << (12 + 16));            // Başlangıçta LED kapalı

  #endif
#endif

#if RTC_CMSIS
    RTC_Init();

    // Saat ve tarih ayarla (bir kez yapılır, sonra RTC bağımsız çalışır)
    RTC_SetTime(14, 30, 0);           // 14:30:00
    RTC_SetDate(25, 6, 28, 6);        // 2025, Haziran, 28, Cumartesi (6)

    // Alarm: 14:30:10'da tetiklenecek
    RTC_SetAlarm(14, 30, 10);
#endif

#if FLASH_CMSIS
    // Kullanıcı verisi için Sektör 6 seçildi (0x08040000, 128 KB)
    // UYARI: Uygulama kodunun bulunduğu sektörü silmeyin!

    // 1. Sektörü sil
    Flash_EraseSector(6);

    // 2. Veri yaz
    Flash_WriteBuffer(FLASH_SECTOR6_ADDR, write_data, 4);

    // 3. Veriyi geri oku ve doğrula
    Flash_ReadBuffer(FLASH_SECTOR6_ADDR, read_data, 4);
#endif
  /* USER CODE END 2 */

  /* Infinite loop */
  while (1)
  {

    /* USER CODE BEGIN 3 */
#if ADC_CMSIS
    adc_value = ADC1_Read();
#endif

#if DAC_CMSIS
    DAC_Set_Voltage(1.65f);
    for (volatile int i = 0; i < 1000000; i++);
#endif

#if PWM_CMSIS
    /* PWM timer tabanlı çalışır, burada ek işlem gerekmez */
#endif

#if GPIO_Interrupt_CMSIS
    /* Interrupt tabanlı, burada ek işlem gerekmez */
#endif

#if TIMER_CMSIS
    __WFI();   /* Interrupt gelene kadar CPU'yu uyut */
#endif

#if UART_CMSIS
    char c = USART2_Read_Char();
    USART2_Send_Char(c);
#endif

#if I2C_CMSIS
    /* I2C işlemleri burada */
#endif

#if SPI_CMSIS
  uint8_t tx_data[] = {0x9F};          // Örnek komut (JEDEC ID okuma)
  uint8_t rx_data[3] = {0};

  SPI1_CS_Low();                        // CS aktif et
  SPI1_Transmit(tx_data, 1);           // Komut gönder
  SPI1_Receive(rx_data, 3);            // 3 byte oku
  SPI1_CS_High();                       // CS pasif et
#endif

#if SYSTICK_CMSIS
  // Örnek 1: delay_ms kullanımı
  GPIOD->BSRR = (1 << 12);          // PD12 LED aç
  delay_ms(500);                     // 500 ms bekle
  GPIOD->BSRR = (1 << (12 + 16));   // PD12 LED kapat
  delay_ms(500);                     // 500 ms bekle

  // Örnek 2: delay_us kullanımı
  GPIOD->BSRR = (1 << 12);          // PD12 LED aç
  delay_us(100);                     // 100 µs bekle
  GPIOD->BSRR = (1 << (12 + 16));   // PD12 LED kapat
  delay_us(100);                     // 100 µs bekle

  // Örnek 3: GetTick ile non-blocking zaman ölçümü
  uint32_t start = GetTick();
  // ... başka işler ...
  uint32_t elapsed = GetTick() - start;  // Geçen süre (ms)
#endif

#if DMA_CMSIS
  // adc_buf[] sürekli güncelleniyor, CPU serbest
  // UART transferi tamamlandıysa yeni mesaj gönderilebilir:
  // if(DMA1->HISR & DMA_HISR_TCIF6) { DMA_UART_Transmit(...); }
#endif

#if WATCHDOG_CMSIS

  #if (WDG_TEST_SELECT == 1)
    /* TEST A: 3. saniyede kasıtlı kilitlenme */
    static uint32_t test_a_counter = 0;

    if(!test_a_locked){
        IWDG_Refresh();
        HAL_Delay(1000);
        test_a_counter++;

        if(test_a_counter == 3){
            test_a_locked = 1;   /* Watch'tan bu değişimi gözlemleyebilirsin */
            while(1){
                __NOP();          /* IWDG_Refresh çağrılmıyor -> ~2 sn sonra reset */
            }
        }
    }

  #elif (WDG_TEST_SELECT == 2)
    /* TEST B1: Sayaç hâlâ W(0x5F)'nin üzerinde (0x7F), refresh -> ANINDA RESET */
    WWDG_Refresh(0x7F);
    while(1){ __NOP(); }   /* Reset olmazsa buraya takılı kalır (hata durumu) */

  #elif (WDG_TEST_SELECT == 3)
    /* TEST B2: Refresh çağrılmıyor, ~50 ms içinde timeout reseti bekleniyor */
    __NOP();

  #elif (WDG_TEST_SELECT == 4)
    wwdg_current = WWDG->CR & WWDG_CR_T;

    if(wwdg_current <= 0x5F){
        WWDG_Refresh(0x7F);
        GPIOD->ODR ^= (1 << 12);
    }
  #endif

#endif

#if RTC_CMSIS
    // Saat ve tarih oku
    RTC_GetTime(&hour, &min, &sec);
    RTC_GetDate(&year, &month, &day, &weekday);

    // Timestamp kontrolü
    RTC_GetTimestamp(&ts_h, &ts_m, &ts_s);

    HAL_Delay(1000);
#endif

#if FLASH_CMSIS
    // Flash işlemleri tamamlandı, ana döngüde ek işlem gerekmez
#endif
  }
  /* USER CODE END 3 */
}

void SystemClock_Config(void)
{
  RCC_OscInitTypeDef RCC_OscInitStruct = {0};
  RCC_ClkInitTypeDef RCC_ClkInitStruct = {0};

  /** Configure the main internal regulator output voltage
  */
  __HAL_RCC_PWR_CLK_ENABLE();
  __HAL_PWR_VOLTAGESCALING_CONFIG(PWR_REGULATOR_VOLTAGE_SCALE1);

  /** Initializes the RCC Oscillators according to the specified parameters
  * in the RCC_OscInitTypeDef structure.
  */
  RCC_OscInitStruct.OscillatorType = RCC_OSCILLATORTYPE_HSE;
  RCC_OscInitStruct.HSEState = RCC_HSE_ON;
  RCC_OscInitStruct.PLL.PLLState = RCC_PLL_ON;
  RCC_OscInitStruct.PLL.PLLSource = RCC_PLLSOURCE_HSE;
  RCC_OscInitStruct.PLL.PLLM = 8;
  RCC_OscInitStruct.PLL.PLLN = 336;
  RCC_OscInitStruct.PLL.PLLP = RCC_PLLP_DIV2;
  RCC_OscInitStruct.PLL.PLLQ = 7;
  if (HAL_RCC_OscConfig(&RCC_OscInitStruct) != HAL_OK)
  {
    Error_Handler();
  }

  /** Initializes the CPU, AHB and APB buses clocks
  */
  RCC_ClkInitStruct.ClockType = RCC_CLOCKTYPE_HCLK|RCC_CLOCKTYPE_SYSCLK
                              |RCC_CLOCKTYPE_PCLK1|RCC_CLOCKTYPE_PCLK2;
  RCC_ClkInitStruct.SYSCLKSource = RCC_SYSCLKSOURCE_PLLCLK;
  RCC_ClkInitStruct.AHBCLKDivider = RCC_SYSCLK_DIV1;
  RCC_ClkInitStruct.APB1CLKDivider = RCC_HCLK_DIV4;
  RCC_ClkInitStruct.APB2CLKDivider = RCC_HCLK_DIV2;

  if (HAL_RCC_ClockConfig(&RCC_ClkInitStruct, FLASH_LATENCY_5) != HAL_OK)
  {
    Error_Handler();
  }
}

static void MX_GPIO_Init(void)
{

  /* GPIO Ports Clock Enable */
  __HAL_RCC_GPIOH_CLK_ENABLE();

}

void Error_Handler(void)
{
  __disable_irq();
  while (1)
  {
  }
}
